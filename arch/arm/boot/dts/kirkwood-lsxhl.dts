/dts-v1/;

#include "kirkwood-lsxl.dtsi"

/ {
	model = "Buffalo Linkstation LS-XHL";
	compatible = "buffalo,lsxhl", "buffalo,lsxl", "marvell,kirkwood-88f6281", "marvell,kirkwood";

	memory {
		device_type = "memory";
		reg = <0x00000000 0x10000000>;
	};
};

&uart0 {
	status = "okay";
};
